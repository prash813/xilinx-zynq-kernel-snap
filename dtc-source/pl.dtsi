/*
 * CAUTION: This file is automatically generated by Xilinx.
 * Version: HSI 2016.3
 * Today is: Wed Jan 11 12:34:24 2017
*/


/ {
	amba_pl: amba_pl {
		#address-cells = <1>;
		#size-cells = <1>;
		compatible = "simple-bus";
		ranges ;
		iam_vmpp_fpga_0: iam_vmpp_fpga@43c00000 {
			compatible = "xlnx,iam-vmpp-fpga-1.8";
			reg = <0x43c00000 0x10000>;
		};
	};
};
